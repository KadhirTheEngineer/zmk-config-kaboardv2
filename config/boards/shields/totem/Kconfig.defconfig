## config/boards/shields/totem/Kconfig.defconfig
```kconfig
# Copyright (c) 2022 The ZMK Contributors
# SPDX-License-Identifier: MIT

if SHIELD_KABOARD_LEFT

config ZMK_KEYBOARD_NAME
    default "KABOARD"
    
config ZMK_SPLIT_ROLE_CENTRAL
    default y

endif

if SHIELD_KABOARD_LEFT || SHIELD_KABOARD_RIGHT

config ZMK_SPLIT
    default y

endif
```

## config/boards/shields/totem/Kconfig.shield
```kconfig
# Copyright (c) 2022 The ZMK Contributors
# SPDX-License-Identifier: MIT

config SHIELD_KABOARD_LEFT
    def_bool $(shields_list_contains,kaboard_left)

config SHIELD_KABOARD_RIGHT
    def_bool $(shields_list_contains,kaboard_right)
```
